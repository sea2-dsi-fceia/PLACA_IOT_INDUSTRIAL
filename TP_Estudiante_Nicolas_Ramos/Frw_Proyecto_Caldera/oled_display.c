/**
 * @file oled_display.c
 * @brief Plantilla OLED SH1106: fuente 6x8 ASCII completa y oled_show(texto).
 */

#include "oled_display.h"
#include <string.h>
#include <stdbool.h>

#if defined(__ESP_IDF__) || defined(ESP_PLATFORM)
#include "driver/i2c.h"
#include "freertos/task.h"
#define I2C_NUM    I2C_NUM_0
#define I2C_FREQ   100000
#define I2C_TIMEOUT_MS  100
#endif

#if defined(__ESP_IDF__) || defined(ESP_PLATFORM)
/* Fuente 6x8: caracteres ASCII 32..126 (95 caracteres × 6 bytes).
   Origen: estilo SSD1306xLED / Tiny4kOLED (dominio público). */
static const uint8_t font_6x8[95][6] = {
    { 0x00, 0x00, 0x00, 0x00, 0x00, 0x00 }, /*   space */
    { 0x00, 0x00, 0x00, 0x2f, 0x00, 0x00 }, /* ! */
    { 0x00, 0x00, 0x07, 0x00, 0x07, 0x00 }, /* " */
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    { 0x00, 0x08, 0x04, 0x08, 0x10, 0x08 }, /* ~ */
};
#endif /* __ESP_IDF__ || ESP_PLATFORM */

#define CHAR_W  6
#define CHAR_H  8
#define COLS    (OLED_ANCHO / CHAR_W)   /* ~21 */
#define PAGES   (OLED_ALTO / CHAR_H)    /* 8 */

#if defined(__ESP_IDF__) || defined(ESP_PLATFORM)
static bool oled_initialized = false;
static uint8_t oled_cmd_buf[4];
#endif

#if defined(__ESP_IDF__) || defined(ESP_PLATFORM)
static esp_err_t i2c_send_cmd(uint8_t cmd)
{
    oled_cmd_buf[0] = 0x00;
    oled_cmd_buf[1] = cmd;
    return i2c_master_write_to_device(I2C_NUM, OLED_ADDR, oled_cmd_buf, 2, pdMS_TO_TICKS(I2C_TIMEOUT_MS));
}

static esp_err_t i2c_send_cmd2(uint8_t a, uint8_t b)
{
    oled_cmd_buf[0] = 0x00;
    oled_cmd_buf[1] = a;
    oled_cmd_buf[2] = b;
    return i2c_master_write_to_device(I2C_NUM, OLED_ADDR, oled_cmd_buf, 3, pdMS_TO_TICKS(I2C_TIMEOUT_MS));
}

static esp_err_t i2c_send_data(const uint8_t *data, size_t len)
{
    if (len == 0) return ESP_OK;
    uint8_t *buf = (uint8_t *)data;
    /* SH1106: cada transferencia empieza con 0x40 (datos) */
    uint8_t packet[1 + 32];
    packet[0] = 0x40;
    for (size_t i = 0; i < len; i += 31) {
        size_t n = (len - i) > 31 ? 31 : (len - i);
        memcpy(packet + 1, buf + i, n);
        if (i2c_master_write_to_device(I2C_NUM, OLED_ADDR, packet, 1 + n, pdMS_TO_TICKS(I2C_TIMEOUT_MS)) != ESP_OK)
            return ESP_FAIL;
    }
    return ESP_OK;
}

static void oled_set_pos(uint8_t page, uint8_t col)
{
    i2c_send_cmd(0xB0 + (page & 0x07));
    i2c_send_cmd(0x00 + (col & 0x0F));
    i2c_send_cmd(0x10 + ((col >> 4) & 0x0F));
}

static void oled_sh1106_init(void)
{
    i2c_send_cmd(0xAE);       /* display off */
    i2c_send_cmd2(0xD5, 0x80);
    i2c_send_cmd2(0xA8, 0x3F);
    i2c_send_cmd2(0xD3, 0x00);
    i2c_send_cmd(0x40);
    i2c_send_cmd(0xA1);
    i2c_send_cmd(0xC8);
    i2c_send_cmd2(0xDA, 0x12);
    i2c_send_cmd2(0x81, 0xCF);
    i2c_send_cmd2(0xD9, 0xF1);
    i2c_send_cmd2(0xDB, 0x40);
    i2c_send_cmd(0xA4);
    i2c_send_cmd(0xA6);
    i2c_send_cmd(0xAF);       /* display on */
}
#endif

void oled_display_init(void)
{
#if defined(__ESP_IDF__) || defined(ESP_PLATFORM)
    if (oled_initialized) return;
    i2c_config_t conf = {
        .mode             = I2C_MODE_MASTER,
        .sda_io_num       = OLED_SDA,
        .scl_io_num       = OLED_SCL,
        .sda_pullup_en    = GPIO_PULLUP_ENABLE,
        .scl_pullup_en    = GPIO_PULLUP_ENABLE,
        .master.clk_speed = I2C_FREQ,
    };
    if (i2c_param_config(I2C_NUM, &conf) != ESP_OK)
        return;
    if (i2c_driver_install(I2C_NUM, conf.mode, 0, 0, 0) != ESP_OK)
        return;
    vTaskDelay(pdMS_TO_TICKS(100));
    oled_sh1106_init();
    oled_initialized = true;
#endif
}

void oled_clear(void)
{
#if defined(__ESP_IDF__) || defined(ESP_PLATFORM)
    if (!oled_initialized) return;
    uint8_t zero[31];
    memset(zero, 0, sizeof(zero));
    for (uint8_t page = 0; page < 8; page++) {
        oled_set_pos(page, 0);
        for (int n = 0; n < 132; n += 31) {
            int chunk = (132 - n) > 31 ? 31 : (132 - n);
            i2c_send_data(zero, chunk);
        }
    }
#endif
}

void oled_show(const char *texto)
{
#if defined(__ESP_IDF__) || defined(ESP_PLATFORM)
    if (!oled_initialized)
        oled_display_init();
    if (!texto) return;

    size_t len = strlen(texto);
    if (len > COLS) len = COLS;

    /* Ancho total en píxeles y columna de inicio para centrar */
    int total_w = (int)len * CHAR_W;
    uint8_t start_col = (OLED_ANCHO - total_w) / 2;
    if (start_col > 132 - total_w) start_col = 0;
    /* Página central para una línea (8 píxeles altos) */
    uint8_t page = (PAGES / 2) - 1;
    if (page > 7) page = 2;

    oled_clear();
    oled_set_pos(page, start_col);

    for (size_t i = 0; i < len; i++) {
        uint8_t c = (uint8_t)texto[i];
        if (c < 32 || c > 126) c = 32;
        const uint8_t *glyph = font_6x8[c - 32];
        i2c_send_data(glyph, CHAR_W);
    }
#endif
}
